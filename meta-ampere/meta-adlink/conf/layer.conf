## meta-ampere/meta-adlink/conf/layer.conf
```bitbake
# We have a conf and classes directory, add to BBPATH
BBPATH .= ":${LAYERDIR}"

# We have recipes-* directories, add to BBFILES
BBFILES += "${LAYERDIR}/recipes-*/*/*.bb \
            ${LAYERDIR}/recipes-*/*/*.bbappend"

BBMASK = "meta-ampere/meta-common/recipes-phosphor/console \
          meta-ampere/meta-common/recipes-phosphor/ipmi/phosphor-ipmi-config"

BBFILE_COLLECTIONS += "adlink-layer"
BBFILE_PATTERN_adlink-layer := "^${LAYERDIR}/"
LAYERSERIES_COMPAT_adlink-layer = "nanbield scarthgap"
```

## meta-ampere/meta-adlink/conf/machine/comhpcalt.conf
```bitbake
KMACHINE = "aspeed"
KERNEL_DEVICETREE = "aspeed/${KMACHINE}-bmc-adlink-${MACHINE}.dtb"

PREFERRED_PROVIDER_virtual/bootloader = "u-boot-aspeed"
PREFERRED_PROVIDER_u-boot = "u-boot-aspeed"
PREFERRED_PROVIDER_u-boot-fw-utils = "u-boot-fw-utils-aspeed"
UBOOT_MACHINE = "ast_g5_phy_config"

require conf/machine/include/ast2500.inc
require conf/machine/include/obmc-bsp-common.inc
require conf/distro/include/phosphor-aspeed-spi-master-mode.inc

MACHINE_FEATURES += "\
        obmc-phosphor-chassis-mgmt \
        obmc-phosphor-flash-mgmt \
        obmc-phosphor-fan-mgmt \
        obmc-chassis-state-mgmt \
        obmc-host-state-mgmt \
        obmc-bmc-state-mgmt \
        obmc-host-ipmi \
        "

VOLATILE_LOG_DIR = "no"

OBMC_IMAGE_EXTRA_INSTALL:append = "\
                                   ampere-utils \
                                   ampere-usbnet \
                                   ampere-misc \
                                   adlink-mac-update \
                                   ampere-platform-init \
                                   phosphor-ipmi-blobs \
                                   virtual-media \
                                   x86-power-control \
                                  "

OBMC_IMAGE_EXTRA_INSTALL:append:flash-65536:flash-131072 = "\
                                   lmsensors \
                                   ampere-ipmi-oem \
                                   phosphor-ipmi-blobs \
                                   phosphor-ipmi-blobs-binarystore \
                                   logger-systemd \
                                  "

PREFERRED_PROVIDER_virtual/obmc-chassis-mgmt = "packagegroup-ampere-apps"
PREFERRED_PROVIDER_virtual/obmc-system-mgmt = "packagegroup-ampere-apps"
PREFERRED_PROVIDER_virtual/obmc-host-ipmi-hw = "phosphor-ipmi-ssif"
PREFERRED_PROVIDER_virtual/obmc-flash-mgmt = "packagegroup-ampere-apps"
PREFERRED_PROVIDER_virtual/phosphor-ipmi-fru-hostfw-config ?= "hostboot-inventory-config-native"
PREFERRED_PROVIDER_virtual/phosphor-led-manager-config-native = "comhpcalt-led-manager-config-native"

VIRTUAL-RUNTIME_obmc-host-state-manager = "x86-power-control"
VIRTUAL-RUNTIME_obmc-chassis-state-manager = "x86-power-control"

VIRTUAL-RUNTIME_obmc-inventory-manager = "entity-manager"
VIRTUAL-RUNTIME_obmc-sensors-hwmon = "dbus-sensors"

OVERRIDES .= "${@":ampere" if FLASH_SIZE == '32768' else ":ampere:flash-65536" if FLASH_SIZE == '65536' else ":ampere:flash-131072"}"
```

## meta-ampere/meta-jade/conf/machine/mtjade.conf
```bitbake
KMACHINE = "aspeed"
KERNEL_DEVICETREE = "aspeed/${KMACHINE}-bmc-ampere-${MACHINE}.dtb"

PREFERRED_PROVIDER_virtual/bootloader = "u-boot-aspeed"
PREFERRED_PROVIDER_u-boot = "u-boot-aspeed"
PREFERRED_PROVIDER_u-boot-fw-utils = "u-boot-fw-utils-aspeed"
UBOOT_MACHINE = "ast_g5_phy_config"

require conf/machine/include/ast2500.inc
require conf/machine/include/obmc-bsp-common.inc
require conf/distro/include/phosphor-aspeed-spi-master-mode.inc

# Reformat SPI flash layout to 64MB
FLASH_SIZE = "65536"
FLASH_UBOOT_OFFSET  = "0"
FLASH_KERNEL_OFFSET = "1024"
FLASH_ROFS_OFFSET   = "10240"
FLASH_RWFS_OFFSET   = "43008"

MACHINE_FEATURES += "\
        obmc-phosphor-chassis-mgmt \
        obmc-phosphor-flash-mgmt \
        obmc-phosphor-fan-mgmt \
        obmc-chassis-state-mgmt \
        obmc-host-state-mgmt \
        obmc-bmc-state-mgmt \
        obmc-host-ipmi \
        "

OBMC_COMPATIBLE_NAMES = "com.ampere.Hardware.Chassis.Model.MtJade"

OBMC_IMAGE_EXTRA_INSTALL:append = "\
                                   phosphor-ipmi-blobs \
                                   phosphor-ipmi-blobs-binarystore \
                                   mtjade-gpio-config \
                                   ac01-boot-progress \
                                   ampere-openocd \
                                  "

PREFERRED_PROVIDER_virtual/obmc-chassis-mgmt = "packagegroup-ampere-apps"
PREFERRED_PROVIDER_virtual/obmc-system-mgmt = "packagegroup-ampere-apps"
PREFERRED_PROVIDER_virtual/obmc-host-ipmi-hw = "phosphor-ipmi-ssif"
PREFERRED_PROVIDER_virtual/obmc-flash-mgmt = "packagegroup-ampere-apps"
PREFERRED_PROVIDER_virtual/phosphor-ipmi-fru-hostfw-config ?= "hostboot-inventory-config-native"
```
